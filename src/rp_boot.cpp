/**
 * @file rp_boot.cpp
 * @brief RP2354B flashing through the RP2350 ROM UART boot — see rp_boot.h.
 */
#include <Arduino.h>
#include "rp_boot.h"
#include "wuadvi_config.h"

/* Library-internal, generated by scripts/library_build.py (declared as this
 * library's extraScript in library.json).  Carries the display-engine image as
 * a C array, so it must never be reached from a public header. */
#include "wuadvi_rp_payload.h"

#ifndef WUADVI_RP_PAYLOAD_PRESENT
#error "WuaDVI-lib: the library build hook did not generate the RP payload header"
#endif

#define BOOT_BAUD        1000000u
#define CHUNK            32u   /* ROM 'w'/'r' transfer unit           */
#define STUB_REGION_SIZE 4096u /* must match stub.c / stub.ld         */
#define HDR_SIZE         256u
#define HDR_MAGIC        0x4C464457u /* "WDFL" — must match stub.c          */

/* ------------------------------------------------------------------ */
/* Pin handling                                                         */
/* ------------------------------------------------------------------ */
/* RUN and BOOTSEL have a pull-up and a push button in parallel: they are
 * driven open-drain style (OUTPUT LOW to assert, INPUT to release). */

/** @brief Drive a pin actively low. */
static void drive_low(uint8_t pin) {
    pinMode(pin, OUTPUT);
    digitalWrite(pin, LOW);
}
/** @brief Drive a pin actively high. */
static void drive_high(uint8_t pin) {
    pinMode(pin, OUTPUT);
    digitalWrite(pin, HIGH);
}
/** @brief Release a pin to high impedance. */
static void release(uint8_t pin) { pinMode(pin, INPUT); }

void rp_boot_release_pins(void) {
    release(WUADVI_PIN_RP_RUN);
    release(WUADVI_PIN_RP_BOOTSEL);
    release(WUADVI_PIN_RP_SD1);
    release(WUADVI_PIN_UART_TX);
    release(WUADVI_PIN_UART_RX);
}

void rp_boot_reset_normal(void) {
    release(WUADVI_PIN_RP_BOOTSEL);
    release(WUADVI_PIN_RP_SD1);
    drive_low(WUADVI_PIN_RP_RUN);
    delay(20);
    release(WUADVI_PIN_RP_RUN);
}

/* ------------------------------------------------------------------ */
/* ROM protocol primitives                                              */
/* ------------------------------------------------------------------ */
/**
 * @brief Wait for one specific byte on the boot UART.
 * @param expected    Byte the ROM is expected to send (command echo).
 * @param timeout_ms  Give-up window.
 * @return true if the next received byte matches within the window.
 */
static bool wait_byte(uint8_t expected, uint32_t timeout_ms) {
    uint32_t t0 = millis();
    while (millis() - t0 < timeout_ms) {
        if (Serial0.available()) {
            uint8_t b = (uint8_t)Serial0.read();
            return b == expected;
        }
    }
    return false;
}

/** @brief Drop every pending byte on the boot UART RX. */
static void flush_rx(void) {
    while (Serial0.available())
        (void)Serial0.read();
}

/**
 * @brief Wait for the "RP2350" banner the ROM prints on UART-boot entry.
 * @param timeout_ms  Give-up window.
 * @return true if the full banner was seen.
 */
static bool wait_banner(uint32_t timeout_ms) {
    static const char pat[] = "RP2350";
    uint32_t t0 = millis();
    uint32_t idx = 0;
    while (millis() - t0 < timeout_ms) {
        if (!Serial0.available())
            continue;
        char c = (char)Serial0.read();
        idx = (c == pat[idx]) ? idx + 1 : (c == pat[0] ? 1 : 0);
        if (pat[idx] == '\0')
            return true;
    }
    return false;
}

/**
 * @brief Send the ROM knock sequence until it responds.
 *
 * Mirrors the official example (pico-examples bootloaders/uart): knock plus
 * a 'n' NOP; the echoed 'n' confirms the ROM is listening.
 *
 * @return true once the ROM acknowledges (up to 10 attempts).
 */
static bool send_knock(void) {
    for (int attempt = 0; attempt < 10; ++attempt) {
        flush_rx();
        const uint8_t knock[5] = {0x56, 0xff, 0x8b, 0xe4, 'n'};
        Serial0.write(knock, sizeof(knock));
        Serial0.flush();
        if (wait_byte('n', 20))
            return true;
    }
    return false;
}

/**
 * @brief Send a single-byte ROM command and wait for its echo.
 * @param c  Command character ('c', 'x', ...).
 * @return true if the ROM echoed it within 100 ms.
 */
static bool cmd_simple(char c) {
    Serial0.write((uint8_t)c);
    Serial0.flush();
    return wait_byte((uint8_t)c, 100);
}

/**
 * @brief Write one logical region to the RP SRAM via 'w' commands.
 *
 * Sends `len` bytes of `data` followed by `fill` padding up to `padded_len`
 * (a multiple of 32), advancing the ROM's write pointer.
 *
 * @param data        Source bytes (may be NULL only if len == 0).
 * @param len         Real payload length.
 * @param padded_len  Total region length written (multiple of CHUNK).
 * @param fill        Padding byte value.
 * @return true if every chunk was echoed by the ROM.
 */
static bool write_region(const uint8_t *data, uint32_t len,
                         uint32_t padded_len, uint8_t fill) {
    uint8_t buf[1 + CHUNK];
    for (uint32_t off = 0; off < padded_len; off += CHUNK) {
        buf[0] = 'w';
        for (uint32_t i = 0; i < CHUNK; ++i) {
            uint32_t src = off + i;
            buf[1 + i] = (src < len) ? data[src] : fill;
        }
        Serial0.write(buf, sizeof(buf));
        if (!wait_byte('w', 50)) {
            Serial.printf("[BOOT] no 'w' echo at offset %lu\n", (unsigned long)off);
            return false;
        }
        /* Yield every 8 KB so the IDLE task runs (ESP32-C3 task watchdog). */
        if ((off & 0x1FFFu) == 0u)
            delay(1);
    }
    return true;
}

#if RP_BOOT_VERIFY
/**
 * @brief Read one logical region back with 'r' and compare.
 * @param data        Expected payload bytes.
 * @param len         Real payload length.
 * @param padded_len  Total region length to verify (multiple of CHUNK).
 * @param fill        Expected padding byte value.
 * @return true if every byte matches.
 */
static bool verify_region(const uint8_t *data, uint32_t len,
                          uint32_t padded_len, uint8_t fill) {
    for (uint32_t off = 0; off < padded_len; off += CHUNK) {
        Serial0.write((uint8_t)'r');
        for (uint32_t i = 0; i < CHUNK; ++i) {
            uint32_t t0 = millis();
            while (!Serial0.available()) {
                if (millis() - t0 > 50) {
                    Serial.printf("[BOOT] 'r' timeout at offset %lu\n",
                                  (unsigned long)(off + i));
                    return false;
                }
            }
            uint8_t got = (uint8_t)Serial0.read();
            uint32_t src = off + i;
            uint8_t expect = (src < len) ? data[src] : fill;
            if (got != expect) {
                Serial.printf("[BOOT] verify mismatch at offset %lu: 0x%02X != 0x%02X\n",
                              (unsigned long)src, got, expect);
                return false;
            }
        }
        if (!wait_byte('r', 50))
            return false;
        if ((off & 0x1FFFu) == 0u)
            delay(1);
    }
    return true;
}
#endif

/* ------------------------------------------------------------------ */
/* Full sequence                                                        */
/* ------------------------------------------------------------------ */
bool rp_boot_flash(void) {
    bool ok = false;

    /* Payload header the stub validates (see tools/rp-flash-stub/stub.c). */
    uint8_t hdr[HDR_SIZE];
    memset(hdr, 0xFF, sizeof(hdr));
    uint32_t magic = HDR_MAGIC;
    uint32_t size = RP_PAYLOAD_FW_SIZE;
    uint32_t crc = RP_PAYLOAD_FW_CRC32;
    uint32_t version = ((uint32_t)RP_PAYLOAD_VERSION_MAJOR << 16) |
                       ((uint32_t)RP_PAYLOAD_VERSION_MINOR << 8) |
                       (uint32_t)RP_PAYLOAD_VERSION_PATCH;
    memcpy(&hdr[0], &magic, 4);
    memcpy(&hdr[4], &size, 4);
    memcpy(&hdr[8], &crc, 4);
    memcpy(&hdr[12], &version, 4);

    const uint32_t fw_padded = (RP_PAYLOAD_FW_SIZE + 255u) & ~255u;

    Serial.printf("[BOOT] entering UART boot (stub %u B + fw %u B, CRC 0x%08lX)\n",
                  (unsigned)RP_STUB_SIZE, (unsigned)RP_PAYLOAD_FW_SIZE,
                  (unsigned long)RP_PAYLOAD_FW_CRC32);

    /* 1. Reset with the UART-boot straps: RUN=0, CSn=0, SD1=1. */
    drive_low(WUADVI_PIN_RP_RUN);
    drive_low(WUADVI_PIN_RP_BOOTSEL);
    drive_high(WUADVI_PIN_RP_SD1);
    delay(20);

    /* UART must be ready BEFORE releasing reset to catch the banner. */
    Serial0.begin(BOOT_BAUD, SERIAL_8N1, WUADVI_PIN_UART_RX, WUADVI_PIN_UART_TX);
    flush_rx();

    release(WUADVI_PIN_RP_RUN);

    if (!wait_banner(1500)) {
        /* It may simply have been missed: the knock is the real test. */
        Serial.println("[BOOT] 'RP2350' banner not seen (continuing)");
    } else {
        Serial.println("[BOOT] 'RP2350' banner received");
    }

    /* The ROM has sampled the straps: release them (the in-package flash
     * shares these pins and the stub is about to use it). */
    release(WUADVI_PIN_RP_BOOTSEL);
    release(WUADVI_PIN_RP_SD1);

    do {
        if (!send_knock()) {
            Serial.println("[BOOT] no knock response");
            break;
        }
        Serial.println("[BOOT] knock OK");

        if (!cmd_simple('c')) {
            Serial.println("[BOOT] 'c' failed");
            break;
        }

        uint32_t t0 = millis();
        if (!write_region(RP_STUB_BIN, RP_STUB_SIZE, STUB_REGION_SIZE, 0x00))
            break;
        if (!write_region(hdr, HDR_SIZE, HDR_SIZE, 0xFF))
            break;
        if (!write_region(RP_FW_BIN, RP_PAYLOAD_FW_SIZE, fw_padded, 0xFF))
            break;
        Serial.printf("[BOOT] SRAM write complete in %lu ms\n",
                      (unsigned long)(millis() - t0));

#if RP_BOOT_VERIFY
        if (!cmd_simple('c')) {
            Serial.println("[BOOT] 'c' (verify) failed");
            break;
        }
        t0 = millis();
        if (!verify_region(RP_STUB_BIN, RP_STUB_SIZE, STUB_REGION_SIZE, 0x00))
            break;
        if (!verify_region(hdr, HDR_SIZE, HDR_SIZE, 0xFF))
            break;
        if (!verify_region(RP_FW_BIN, RP_PAYLOAD_FW_SIZE, fw_padded, 0xFF))
            break;
        Serial.printf("[BOOT] SRAM verify OK in %lu ms\n",
                      (unsigned long)(millis() - t0));
#endif

        if (!cmd_simple('x')) {
            Serial.println("[BOOT] 'x' failed");
            break;
        }
        Serial.println("[BOOT] 'x' accepted: stub is programming the internal flash...");
        ok = true;
    } while (false);

    /* Release EVERYTHING: while the stub programs and afterwards during XIP,
     * the QSPI bus belongs to the RP's internal flash — the ESP32 must not
     * drive any of its lines. */
    Serial0.end();
    rp_boot_release_pins();

    if (!ok) {
        /* Leave the RP normally reset for the next attempt. */
        rp_boot_reset_normal();
    }
    return ok;
}
